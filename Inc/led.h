#ifndef LED_H_   /* Include guard */
#define LED_H_

#include "stdint.h"
int foo(int x);  /* An example function declaration */

uint8_t disp1ay[38][8]={
{0x04,0x7B,0x04,0x14,0x24,0x14,0x10,0x20},//0
{0x10,0x30,0x50,0x10,0x10,0x10,0x10,0x7c},//1
{0x7E,0x2,0x2,0x7E,0x40,0x40,0x40,0x7E},//2
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{0x0,0x7F,0x2,0x4,0x8,0x10,0x20,0x7F},//Z
};

uint8_t setup_seq [9][8]={
{ 0x81, 0x00, 0x00, 0x00, 0x00, 0x00, 0x00, 0x81}	, //s1
{ 0xC1, 0x01, 0x00, 0x00, 0x00, 0x00, 0x80, 0x83},	 //s2
{ 0xE1, 0x01, 0x01, 0x00, 0x00, 0x80, 0x80, 0x87},	 //s3
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{ 0xFF, 0x81, 0xBD, 0xA5, 0xA5, 0xBD, 0x81, 0xFF},	 //default
};


enum d_face {null,d_face,d_left,d_right,blink};
uint8_t d [7][9] ={
{ 0x00, 0x00, 0x00, 0x00, 0x00, 0x00, 0x00, 0x00},	 //null
{ 0xFF, 0x81, 0xBD, 0xA5, 0xA5, 0xBD, 0x81, 0xFF},	 //default
{ 0xFF, 0x81, 0x81, 0xF1, 0xD1, 0xF1, 0x81, 0xFF},	 //D_left
{ 0xFF, 0x81, 0x81, 0x8F, 0x8B, 0x8F, 0x81, 0xFF},	 //D_right

{ 0xFF, 0x81, 0xBD, 0xA5, 0xA5, 0xBD, 0x81, 0xFF},	 //blink_1
{ 0xFF, 0x81, 0x81, 0xBD, 0xA5, 0xBD, 0x81, 0xFF},	 //blink_2
{ 0xFF, 0x81, 0x81, 0x81, 0xBD, 0x81, 0x81, 0xFF}	 //blink_3

};


void write_byte(uint8_t byte)
{
	    for(int i=0;i<8;i++)
          {
	    	 HAL_GPIO_WritePin(GPIOA, GPIO_PIN_5, 0);  // Pull the CLK LOW
	    	 HAL_GPIO_WritePin(GPIOA, GPIO_PIN_7, byte&0x80);// Write one BIT data MSB first
             byte = byte<<1;  // shift the data to the left
             HAL_GPIO_WritePin(GPIOA, GPIO_PIN_5, 1);  // Pull the CLK HIGH
           }
}

void write_max (uint8_t address, uint8_t data)
{
	HAL_GPIO_WritePin(GPIOA, GPIO_PIN_6, 0);   // Pull the CS pin LOW
    write_byte(address);   //  write address
    write_byte(data);  //  write data
    HAL_GPIO_WritePin(GPIOA, GPIO_PIN_6, 1);  // pull the CS HIGH
}

void max_init(void)
{
 write_max(0x09, 0x00);       //  no decoding
 write_max(0x0a, 0x03);       //  brightness intensity
 write_max(0x0b, 0x07);       //  scan limit = 8 LEDs
 write_max(0x0c, 0x01);       //  power down =0,normal mode = 1
 write_max(0x0f, 0x00);       //  no test display
}

void write_string (char *str)
{
	while (*str)
	{
		for(int i=1;i<9;i++)
			   {
			       write_max (i,disp1ay[(*str - 55)][i-1]);
			   }
		*str++;
		HAL_Delay (500);
	}
}


void led_startup ()
{
	{
		for(int j=0;j<9;j++){
		for(int i=1;i<9;i++)
			   {
			       write_max (i,setup_seq[j][i-1]);
					 HAL_Delay (30);
			   }
			 }

		
	}
}

void led_d_face (int k){
	if(k<4){
	for(int i=1;i<9;i++)
			   {
			       write_max (i,d[k][i-1]);
					 HAL_Delay (30);
			   }
			 }
	else if(k==4){
		for(int j=4;j<7;j++){
		for(int i=1;i<9;i++)
			   {
			       write_max (i,d[j][i-1]);
					 HAL_Delay (30);
			   }
			 }
		HAL_Delay (500);	
	}
}


#endif // LED_H_
